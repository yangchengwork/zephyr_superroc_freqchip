## drivers/gpio/Kconfig.freqchip
```kconfig
# Copyright (c) 2025 Freqchip
# SPDX-License-Identifier: Apache-2.0

config GPIO_FREQCHIP
	bool "GPIO Driver for Freqchip family of MCUs"
	default y
	depends on DT_HAS_FREQCHIP_FREQCHIP_GPIO_ENABLED
	help 
		Enable GPIO driver for Freqchip line of MCUs

config GPIO_FREQCHIP_INTERRUPT
	bool "Interrupt support"
	depends on GPIO_FREQCHIP
	default y
	help
	  The option can be used to disable the GPIO interrupt support to
	  significantly reduce memory footprint in case of application that does
	  not need GPIO interrupts.
```

## drivers/pwm/Kconfig.freqchip
```kconfig
# Copyright (c) 2025 Freqchip
# SPDX-License-Identifier: Apache-2.0

config PWM_FREQCHIP
	bool "PWM Driver for Freqchip family of MCUs"
	default y
	depends on DT_HAS_FREQCHIP_FREQCHIP_PWM_ENABLED
```

## dts/bindings/led/freqchip-leds.yaml
```yaml
# dts/bindings/led/freqchip-leds.yaml
description: freqchip PWM LED with GPIO configuration

compatible: "freqchip,pwm-gpio-led"

include: pwm-leds.yaml  # 继承pwm-leds.yaml的属性

properties:
  gpios:
    type: phandle-array
    description: GPIO pin for LED control
    required: true
```
